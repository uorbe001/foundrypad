## boards/shields/foundrypad/Kconfig.defconfig
```kconfig
if SHIELD_FOUNDRYPAD

# Name must be less than 16 characters long!
config ZMK_KEYBOARD_NAME
    default "Foundrypad"

endif
```

## boards/shields/foundrypad/Kconfig.shield
```kconfig
# No whitespace after the comma or in your keyboard name!
config SHIELD_FOUNDRYPAD
    def_bool $(shields_list_contains,foundrypad)
```
